## CMakeLists.txt
```
# SPDX-License-Identifier: Apache-2.0

cmake_minimum_required(VERSION 3.13.1)
find_package(Zephyr REQUIRED HINTS $ENV{ZEPHYR_BASE})
project(bluetooth_init)

include_directories(
  include
)

FILE(GLOB app_sources src/*.c)
target_sources(app PRIVATE ${app_sources})
```

## prj.conf
```kconfig
CONFIG_TEST=y
CONFIG_ZTEST=y


CONFIG_BT=y
CONFIG_BT_OBSERVER=y
CONFIG_BT_BROADCASTER=y

CONFIG_BT_DEBUG_LOG=y
CONFIG_BT_NO_DRIVER=y
CONFIG_BT_ID_MAX=1
```

## prj_privacy.conf
```kconfig
CONFIG_TEST=y
CONFIG_ZTEST=y

CONFIG_BT=y
CONFIG_BT_OBSERVER=y
CONFIG_BT_BROADCASTER=y
CONFIG_BT_PRIVACY=y

CONFIG_BT_DEBUG_LOG=y
CONFIG_BT_NO_DRIVER=y
CONFIG_BT_ID_MAX=1
```

## prj_privacy_scan_identity.conf
```kconfig
CONFIG_TEST=y
CONFIG_ZTEST=y

CONFIG_BT=y
CONFIG_BT_OBSERVER=y
CONFIG_BT_BROADCASTER=y

CONFIG_BT_PRIVACY=y
CONFIG_BT_SCAN_IDENTITY=y

CONFIG_BT_DEBUG_LOG=y
CONFIG_BT_NO_DRIVER=y
CONFIG_BT_ID_MAX=1
```

## prj_scan_identity.conf
```kconfig
CONFIG_TEST=y
CONFIG_ZTEST=y

CONFIG_BT=y
CONFIG_BT_OBSERVER=y
CONFIG_BT_BROADCASTER=y

CONFIG_BT_SCAN_IDENTITY=y

CONFIG_BT_DEBUG_LOG=y
CONFIG_BT_NO_DRIVER=y
CONFIG_BT_ID_MAX=1
```

## src/main.c
```c
/*
 * Copyright (c) 2015 Wind River Systems, Inc.
 * Copyright (c) 2018 Intel Corporation
 *
 * SPDX-License-Identifier: Apache-2.0
 */

#include <ztest.h>
#include <stdbool.h>
#include <bluetooth/bluetooth.h>
#include <bluetooth/addr.h>

#include "mocked_controller.h"

static const bt_addr_le_t peer_addr =
{
	.type = BT_ADDR_LE_RANDOM,
	.a = {.val = {0x1, 0x2, 0x3, 0x4, 0x5, 0x6}}
};

static bt_addr_le_t ids[CONFIG_BT_ID_MAX];

static void check_adv_random_addr(struct bt_le_adv_param *adv_param,
								  bool active_scanner_or_initiator_enabled)
{
	bool expect_success = true;

	bt_addr_t random_addr;
	bool random_addr_valid;

	bool random_addr_shall_contain_identity =
		(adv_param->options & BT_LE_ADV_OPT_USE_IDENTITY);

	if (active_scanner_or_initiator_enabled) {
		/* Only accept when the advertiser and scanner/initiator are using
		 * the same address.
		 *
		 * TODO: Add other conditions
		 *  */

		if (random_addr_shall_contain_identity)
			expect_success = false;
	}

	if (expect_success) {
		zassert_equal(bt_le_adv_start(adv_param, NULL, 0, NULL, 0), 0,
				"Advertising start failed");
	} else {
		zassert_equal(bt_le_adv_start(adv_param, NULL, 0, NULL, 0), -EIO,
				"Advertising start succeeded");
		return;
	}

	mocked_controller_random_addr_get(&random_addr, &random_addr_valid);
	zassert_true(random_addr_valid, "Needs a valid random address");

	bool random_addr_is_identity =
			(memcmp(&random_addr,
				    &ids[BT_ID_DEFAULT].a,
				    sizeof(random_addr)) == 0);

	zassert_equal(random_addr_shall_contain_identity, random_addr_is_identity,
			"Random address contains identity: %d \n"
			"Connectable: %d\n"
			"Scannable: %d\n"
			"Directed: %d\n"
			"Use identity %d\n"
			"Privacy enabled %d",
			random_addr_is_identity,
			(adv_param->options & BT_LE_ADV_OPT_CONNECTABLE) != 0,
			(adv_param->options & BT_LE_ADV_OPT_SCANNABLE) != 0,
			adv_param->peer != NULL,
			(adv_param->options & BT_LE_ADV_OPT_USE_IDENTITY) != 0,
			IS_ENABLED(BT_PRIVACY));

	zassert_equal(bt_le_adv_stop(), 0, "Adv stop failed");
}

static void test_legacy_adv_scanner(bool active_scanner_or_initiator_enabled)
{
	struct bt_le_adv_param adv_param =
			BT_LE_ADV_PARAM_INIT(BT_LE_ADV_OPT_NONE,
					BT_GAP_ADV_FAST_INT_MIN_2,
					BT_GAP_ADV_FAST_INT_MIN_2,
					NULL);
	bool use_identity[] = {true};

	/* Undirected advertising types */
	uint32_t undirected_options[] =
	{
		BT_LE_ADV_OPT_NONE,

		/* TODO: When BT_LE_ADV_OPT_USE_IDENTITY is NOT set,
		 * we still advertise with identity address */
		BT_LE_ADV_OPT_CONNECTABLE,
		BT_LE_ADV_OPT_CONNECTABLE | BT_LE_ADV_OPT_SCANNABLE,
		BT_LE_ADV_OPT_SCANNABLE,
	};

	for (int i = 0; i < ARRAY_SIZE(undirected_options); i++) {
		for (int j = 0; j < ARRAY_SIZE(use_identity); j++) {
			adv_param.options = undirected_options[i];
			if (use_identity[j]) {
				adv_param.options |= BT_LE_ADV_OPT_USE_IDENTITY;
			}

			check_adv_random_addr(&adv_param, active_scanner_or_initiator_enabled);
		}
	}

	/* Directed advertising types*/
	uint32_t directed_options[] =
	{
		BT_LE_ADV_OPT_CONNECTABLE,
		BT_LE_ADV_OPT_CONNECTABLE | BT_LE_ADV_OPT_DIR_MODE_LOW_DUTY,
	};

	adv_param.peer = &peer_addr;

	for (int i = 0; i < ARRAY_SIZE(directed_options); i++) {
		for (int j = 0; j < ARRAY_SIZE(use_identity); j++) {
			adv_param.options = directed_options[i];
			if (use_identity[j]) {
				adv_param.options |= BT_LE_ADV_OPT_USE_IDENTITY;
			}

			check_adv_random_addr(&adv_param, active_scanner_or_initiator_enabled);
		};
	}
}

/**
 * @brief Test integer arithmetic operations
 *
 * @details Test multiplication and division of two
 * integers
 */
void test_legacy_adv_no_scan(void)
{
	test_legacy_adv_scanner(false);
}

void test_legacy_adv_passive_scan(void)
{
	zassert_equal(bt_le_scan_start(BT_LE_SCAN_PASSIVE, NULL), 0,
			"Scan start failed");

	test_legacy_adv_scanner(false);

	zassert_equal(bt_le_scan_stop(), 0, "Scan stop failed");
}

void test_legacy_adv_active_scan(void)
{
	zassert_equal(bt_le_scan_start(BT_LE_SCAN_ACTIVE, NULL), 0,
			"Scan start failed");

	test_legacy_adv_scanner(true);

	zassert_equal(bt_le_scan_stop(), 0, "Scan stop failed");
}

void test_main(void)
{
	zassert_equal(bt_enable(NULL), 0,
				  "bt_enable failed");

	size_t id_count = CONFIG_BT_ID_MAX;
	bt_id_get(ids, &id_count);
	zassert_equal(id_count, 1,
		"Expect only one ID to be present after bt_enable()");

	/* Configurations to be tested:
	 *
	 * - identity is public/random
	 * - Passive scanner running at the same time -> no change
	 * - active scanner uses identity/NRPA
	 * - initiator
	 *
	 * TODO: Execute test with multiple identities */

	ztest_test_suite(test_legacy_adv,
			 ztest_unit_test(test_legacy_adv_no_scan),
			 ztest_unit_test(test_legacy_adv_passive_scan),
			 ztest_unit_test(test_legacy_adv_active_scan)
			 );

	ztest_run_test_suite(test_legacy_adv);
}
```

## include/mocked_controller.h
```c
void mocked_controller_random_addr_get(bt_addr_t *addr, bool *valid);
```

## src/mocked_controller.c
```c
#include <ztest.h>
#include <sys/byteorder.h>
#include <drivers/bluetooth/hci_driver.h>
#include <bluetooth/buf.h>

static bool using_extended_commands;
static bool advertising_enabled;

static bool scan_type_active;
static bool scan_enabled;

static bool random_addr_valid;
static bt_addr_t random_addr;
static bool bdaddr_valid;
static bt_addr_t bdaddr;

void mocked_controller_random_addr_get(bt_addr_t *addr, bool *valid)
{
	memcpy(addr, &random_addr, sizeof(random_addr));
	*valid = random_addr_valid;
}



/* Command handler structure for cmd_handle(). */
struct cmd_handler {
	uint16_t opcode; /* HCI command opcode */
	uint8_t len;     /* HCI command response length */
	void (*handler)(struct net_buf *buf, struct net_buf **evt,
			uint8_t len, uint16_t opcode);
};

/* Add event to net_buf. */
static void evt_create(struct net_buf *buf, uint8_t evt, uint8_t len)
{
	struct bt_hci_evt_hdr *hdr;

	hdr = net_buf_add(buf, sizeof(*hdr));
	hdr->evt = evt;
	hdr->len = len;
}

/* Create a command complete event. */
static void *cmd_complete(struct net_buf **buf, uint8_t plen, uint16_t opcode)
{
	struct bt_hci_evt_cmd_complete *cc;

	*buf = bt_buf_get_evt(BT_HCI_EVT_CMD_COMPLETE, false, K_FOREVER);
	evt_create(*buf, BT_HCI_EVT_CMD_COMPLETE, sizeof(*cc) + plen);
	cc = net_buf_add(*buf, sizeof(*cc));
	cc->ncmd = 1U;
	cc->opcode = sys_cpu_to_le16(opcode);
	return net_buf_add(*buf, plen);
}

/* Generic command complete with success status. */
static void generic_success(struct net_buf *buf, struct net_buf **evt,
			    uint8_t len, uint16_t opcode)
{
	struct bt_hci_evt_cc_status *ccst;

	ccst = cmd_complete(evt, len, opcode);

	/* Fill any event parameters with zero */
	(void)memset(ccst, 0, len);

	ccst->status = BT_HCI_ERR_SUCCESS;
}

/* Bogus handler for BT_HCI_OP_READ_LOCAL_FEATURES. */
static void read_local_features(struct net_buf *buf, struct net_buf **evt,
				uint8_t len, uint16_t opcode)
{
	struct bt_hci_rp_read_local_features *rp;

	rp = cmd_complete(evt, sizeof(*rp), opcode);
	rp->status = 0x00;
	(void)memset(&rp->features[0], 0xFF, sizeof(rp->features));
}

/* Bogus handler for BT_HCI_OP_READ_SUPPORTED_COMMANDS. */
static void read_supported_commands(struct net_buf *buf, struct net_buf **evt,
				    uint8_t len, uint16_t opcode)
{
	struct bt_hci_rp_read_supported_commands *rp;

	rp = cmd_complete(evt, sizeof(*rp), opcode);
	(void)memset(&rp->commands[0], 0xFF, sizeof(rp->commands));
	rp->status = 0x00;
}

/* Bogus handler for BT_HCI_OP_LE_READ_LOCAL_FEATURES. */
static void le_read_local_features(struct net_buf *buf, struct net_buf **evt,
				   uint8_t len, uint16_t opcode)
{
	struct bt_hci_rp_le_read_local_features *rp;

	rp = cmd_complete(evt, sizeof(*rp), opcode);
	rp->status = 0x00;
	(void)memset(&rp->features[0], 0xFF, sizeof(rp->features));
}

/* Bogus handler for BT_HCI_OP_LE_READ_SUPP_STATES. */
static void le_read_supp_states(struct net_buf *buf, struct net_buf **evt,
				uint8_t len, uint16_t opcode)
{
	struct bt_hci_rp_le_read_supp_states *rp;

	rp = cmd_complete(evt, sizeof(*rp), opcode);
	rp->status = 0x00;
	(void)memset(&rp->le_states, 0xFF, sizeof(rp->le_states));
}

/* Validation of what has been sent to le_set_random_address. */
static void le_set_random_address(struct net_buf *buf, struct net_buf **evt,
				uint8_t len, uint16_t opcode)
{
	struct bt_hci_evt_cc_status *ccst;
	uint8_t status;

	if ((advertising_enabled && !using_extended_commands) ||
		(scan_enabled && scan_type_active)) {
		status = BT_HCI_ERR_CMD_DISALLOWED;
	} else {
		status = BT_HCI_ERR_SUCCESS;
		memcpy(&random_addr.val[0], (void*)buf->data, sizeof(random_addr));
		random_addr_valid = true;
	}

	ccst = cmd_complete(evt, len, opcode);

	/* Fill any event parameters with zero */
	(void)memset(ccst, 0, len);
	ccst->status = status;
}

static void le_set_scan_params(struct net_buf *buf, struct net_buf **evt,
				uint8_t len, uint16_t opcode)
{
	scan_type_active = net_buf_pull_u8(buf);
	generic_success(buf, evt, len, opcode);
}

static void le_set_scan_enable(struct net_buf *buf, struct net_buf **evt,
				uint8_t len, uint16_t opcode)
{
	scan_enabled = net_buf_pull_u8(buf);
	generic_success(buf, evt, len, opcode);
}

/* Setup handlers needed for bt_enable to function. */
static const struct cmd_handler cmds[] = {
	{ BT_HCI_OP_READ_LOCAL_VERSION_INFO,
	  sizeof(struct bt_hci_rp_read_local_version_info),
	  generic_success },
	{ BT_HCI_OP_READ_SUPPORTED_COMMANDS,
	  sizeof(struct bt_hci_rp_read_supported_commands),
	  read_supported_commands },
	{ BT_HCI_OP_READ_LOCAL_FEATURES,
	  sizeof(struct bt_hci_rp_read_local_features),
	  read_local_features },
	{ BT_HCI_OP_READ_BD_ADDR,
	  sizeof(struct bt_hci_rp_read_bd_addr),
	  generic_success },
	{ BT_HCI_OP_SET_EVENT_MASK,
	  sizeof(struct bt_hci_evt_cc_status),
	  generic_success },
	{ BT_HCI_OP_LE_SET_EVENT_MASK,
	  sizeof(struct bt_hci_evt_cc_status),
	  generic_success },
	{ BT_HCI_OP_LE_READ_LOCAL_FEATURES,
	  sizeof(struct bt_hci_rp_le_read_local_features),
	  le_read_local_features },
	{ BT_HCI_OP_LE_READ_SUPP_STATES,
	  sizeof(struct bt_hci_rp_le_read_supp_states),
	  le_read_supp_states },
	{ BT_HCI_OP_LE_RAND,
	  sizeof(struct bt_hci_rp_le_rand),
	  generic_success },

	/* Custom implementations of commands handling controller
	 * addresses */
	{ BT_HCI_OP_LE_SET_RANDOM_ADDRESS,
	  sizeof(struct bt_hci_evt_cc_status),
	  le_set_random_address },
	{ BT_HCI_OP_LE_SET_SCAN_PARAM,
	  sizeof(struct bt_hci_evt_cc_status),
	  le_set_scan_params },
	{ BT_HCI_OP_LE_SET_SCAN_ENABLE,
	  sizeof(struct bt_hci_evt_cc_status),
	  le_set_scan_enable },
};

static int driver_open(void)
{
	return 0;
}


/* Loop over handlers to try to handle the command given by opcode. */
static void cmd_handle_helper(uint16_t opcode, struct net_buf *cmd,
			     struct net_buf **evt)
{
	for (size_t i = 0; i < ARRAY_SIZE(cmds); i++) {
		const struct cmd_handler *handler = &cmds[i];

		if (handler->opcode != opcode) {
			continue;
		}

		if (handler->handler) {
			handler->handler(cmd, evt, handler->len, opcode);
			return;
		}
	}

	/* Not found, use a generic success implementation */
	generic_success(cmd, evt, sizeof(struct bt_hci_evt_cc_status), opcode);
}


/*  HCI driver send.  */
static int driver_send(struct net_buf *buf)
{
	struct net_buf *evt = NULL;
	struct bt_hci_cmd_hdr *chdr;
	uint16_t opcode;

	chdr = net_buf_pull_mem(buf, sizeof(*chdr));
	opcode = sys_le16_to_cpu(chdr->opcode);

	cmd_handle_helper(opcode, buf, &evt);

	if (evt) {
		bt_recv(evt);
		net_buf_unref(buf);
	}

	return 0;
}

/* HCI driver structure. */
static const struct bt_hci_driver drv = {
	.name         = "mocked_controller",
	.bus          = BT_HCI_DRIVER_BUS_VIRTUAL,
	.open         = driver_open,
	.send         = driver_send,
	.quirks       = 0,
};

static int hci_driver_init(const struct device *unused)
{
	ARG_UNUSED(unused);

	bt_hci_driver_register(&drv);

	return 0;
}

SYS_INIT(hci_driver_init, POST_KERNEL, CONFIG_KERNEL_INIT_PRIORITY_DEVICE);
```
